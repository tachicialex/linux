## Documentation/devicetree/bindings/clock/clk-ad9545.yaml
```yaml
# SPDX-License-Identifier: (GPL-2.0-only OR BSD-2-Clause)
%YAML 1.2
---
$id: http://devicetree.org/schemas/clock/clk-ad9545.yaml#
$schema: http://devicetree.org/meta-schemas/core.yaml#

title: Analog Devices AD9545 Quad Input, 10-Output, Dual DPLL/IEEE 1588

maintainers:
  - Alexandru Tachici <alexandru.tachici@analog.com>

description: |
  Analog Devices AD9545 Quad Input, 10-Output, Dual DPLL/IEEE 1588,
  1 pps Synchronizer and Jitter Cleaner
  https://www.analog.com/media/en/technical-documentation/data-sheets/ADM1266.pdf

properties:
  compatible:
    enum:
      - adi,ad9545

  "#clock-cells":
    const: 1

  reg:
    description: |
      I2C address of the secondary device.

  avcc-supply:
    description: |
      Phandle to the Avcc power supply.

  adi,freq-doubler:
    description: |
      The system clock PLL provides the user with the option of doubling the reference frequency.
    type: boolean

  adi,ref-crystal:
    description: |
      At XOA,XOB there is a crystal connected that needs maintaining.
      Otherwise it is assumed that there is a TCXO or OCXO connected.
    type: boolean

  adi,ref-frequency-mhz:
    description: |
      Reference input frequency at XOA,XOB. This is used for the system clock.
    allOf:
      - $ref: /schemas/types.yaml#/definitions/uint32-array
    minItems: 2
    maxItems: 2

  clocks:
    items:
      - description: Ref A clock input
      - description: Ref AA clock input
      - description: Ref B clock input
      - description: Ref BB clock input

patternProperties:
  "^ref-input-clk@[0-3]$":
    description: |
      Represents a reference clock input.
    type: object

    properties:
      reg:
        description: |
          The reference input number. It can have up to 4 input clocks numbered from 0 to 3.
          (mapped: [refa, refaa, refb, refbb] -> [0, 1, 2, 3])
        maxItems: 1

      adi,single-ended-mode:
        description: |
          Single-ended configuration mode.
        allOf:
          - $ref: /schemas/types.yaml#/definitions/uint32
          - enum: [0, 1, 2, 3]
        maxItems: 1

      adi,differential-mode:
        description: |
          Differential configuration mode.
        allOf:
          - $ref: /schemas/types.yaml#/definitions/uint32
          - enum: [0, 1, 2]
        maxItems: 1

      adi,r-divider-ratio:
        description: |
          Each reference input has a dedicated divider.
        allOf:
          - $ref: /schemas/types.yaml#/definitions/uint32
          - minimum: 0
          - maximum: 0x40000000
        maxItems: 1

      adi,ref-dtol-pbb:
        description: |
          REFx offset limit. Constitutes a fractional portion of the corresponding nominal period.
          The 24-bit number represents fractional units of parts per billion (ppb) up to a
          maximum of approximately 17 million ppb (1.7%).
        allOf:
          - $ref: /schemas/types.yaml#/definitions/uint32
          - minimum: 0
          - maximum: 16777215
          - default: 100000

      adi,ref-monitor-hysteresis-pbb:
        description: |
          Basis points of the offset limit representing per ten thousand of REFx offset limit.
        allOf:
          - $ref: /schemas/types.yaml#/definitions/uint32
          - enum: [0, 3125, 6250, 12500, 25000, 50000, 75000, 87500]
          - default: 12500

      adi,ref-validation-timer-ms:
        description: |
          Time required for a reference to remain in tolerance condition before being
          available to be used.
        allOf:
          - $ref: /schemas/types.yaml#/definitions/uint32
          - minimum: 1
          - maximum: 1048574
          - default: 10

  "^pll-clk@[0-1]$":
    description: |
      Represents a PLL.
    type: object

    properties:
      reg:
        description: |
          PLL number. AD9545 has two PLLs.
        maxItems: 1

      adi,pll-source:
        description: |
          Each PLL can have 1 signal source. Choose from Ref-A to Ref-BB [0-3] or aux NCOs [4-5].
        allOf:
          - $ref: /schemas/types.yaml#/definitions/uint32
          - enum: [0, 1, 2, 3, 4, 5]
        maxItems: 1

      adi,pll-loop-bandwidth-hz:
        description: |
          PLL loop bandwidth.
        allOf:
          - $ref: /schemas/types.yaml#/definitions/uint32
          - minimum: 1
          - maximum: 1850
        maxItems: 1

  "^aux-nco-clk@[0-1]$":
    description: |
      Represents an auxiliary Numerical Controlled Oscilator. Generates timestamps that
      can be sent to the DPLL0 or DPLL1.
    type: object

    properties:
      reg:
        description: |
          Auxiliary NCO address mapped: [NCO0, NCO1] -> [0, 1].
        maxItems: 1

      adi,nco-freq-hz:
        description: |
          Output frequency of this NCO.
        allOf:
          - $ref: /schemas/types.yaml#/definitions/uint32
          - minimum: 1
          - maximum: 65535
        maxItems: 1

  "^output-clk@([0-5]|1[0-3])$":
    description: |
      Represents a clock output.
    type: object

    properties:
      reg:
        description: |
          The reference input number. It can have up to 10 output clocks mapped:
          (OUT0AP OUT0AN OUT0BP OUT0BN OUT0CP OUT0CN OUT1AP OUT1AN OUT1BP OUT1BN) ->
          (0, 1, 2, 3, 4, 5, 6, 7, 8, 9)
        maxItems: 1

      adi,current-source:
        description: |
          If specified output is set as current source.
        type: boolean

      adi,current-source-microamp:
        description: |
          The magnitude of the driver current.
        allOf:
          - $ref: /schemas/types.yaml#/definitions/uint32
          - enum: [7500, 12500, 15000]
        minItems: 1

      adi,output-mode:
        description: |
          Output driver mode.
        allOf:
          - $ref: /schemas/types.yaml#/definitions/uint32
          - enum: [0, 1, 2]
        maxItems: 1

required:
  - compatible
  - reg

examples:
  - |
      clock-ad9545@4A {
        compatible = "adi,ad9545";
        reg = <0x4A>;
        #clock-cells = <1>;
        #address-cells = <1>;
        #size-cells = <0>;

        adi,ref-compensation;
        adi,freq-doubler;
        adi,ref-crystal;
        adi,ref-frequency-mhz = <0x71B00000 0xB>;

        /* ref a*/
        ref-input-clk@0 {
          reg = <0>;
          adi,single-ended-mode = <DRIVER_MODE_DC_COUPLED_1V2>;
          adi,r-divider-ratio = <50>;
          adi,ref-dtol-pbb = <100000>;
          adi,ref-monitor-hysteresis-pbb = <12500>;
          adi,ref-validation-timer-ms = <10>;
        };

        /* ref aa*/
        ref-input-clk@1 {
          reg = <1>;
          adi,single-ended-mode = <DRIVER_MODE_AC_COUPLED>;
          adi,r-divider-ratio = <50>;
          adi,ref-dtol-pbb = <100000>;
          adi,ref-monitor-hysteresis-pbb = <12500>;
          adi,ref-validation-timer-ms = <10>;
        };

        /* ref b*/
        ref-input-clk@2 {
          reg = <2>;
          adi,single-ended-mode = <DRIVER_MODE_DC_COUPLED_1V8>;
          adi,r-divider-ratio = <125>;
          adi,ref-dtol-pbb = <100000>;
          adi,ref-monitor-hysteresis-pbb = <12500>;
          adi,ref-validation-timer-ms = <10>;
        };

        /* ref bb*/
        ref-input-clk@3 {
          reg = <3>;
          adi,single-ended-mode = <DRIVER_MODE_AC_COUPLED>;
          adi,ref-dtol-pbb = <100000>;
          adi,ref-monitor-hysteresis-pbb = <12500>;
          adi,ref-validation-timer-ms = <10>;
        };

        output-clk@0 {
          reg = <0>;
          adi,current-sink;
          adi,output-mode = <DRIVER_MODE_SINGLE_DIV_DIF>;
          adi,current-source-microamp = <12500>;
        };

        output-clk@1 {
          reg = <1>;
          adi,current-sink;
          adi,output-mode = <DRIVER_MODE_SINGLE_DIV_DIF>;
          adi,current-source-microamp = <12500>;
        };

        output-clk@2 {
          reg = <2>;
          adi,current-sink;
          adi,output-mode = <DRIVER_MODE_SINGLE_DIV>;
          adi,current-source-microamp = <15000>;
        };

        output-clk@3 {
          reg = <3>;
          adi,current-sink;
          adi,output-mode = <DRIVER_MODE_SINGLE_DIV>;
          adi,current-source-microamp = <15000>;
        };

        output-clk@4 {
          reg = <4>;
          adi,output-mode = <DRIVER_MODE_SINGLE_DIV_DIF>;
          adi,current-source-microamp = <15000>;
        };

        output-clk@5 {
          reg = <5>;
          adi,output-mode = <DRIVER_MODE_SINGLE_DIV_DIF>;
          adi,current-source-microamp = <15000>;
        };

        output-clk@6 {
          reg = <6>;
          adi,current-sink;
          adi,output-mode = <DRIVER_MODE_SINGLE_DIV>;
          adi,current-source-microamp = <12500>;
        };

        output-clk@7 {
          reg = <7>;
          adi,current-sink;
          adi,output-mode = <DRIVER_MODE_SINGLE_DIV>;
          adi,current-source-microamp = <12500>;
        };

        output-clk@8 {
          reg = <8>;
          adi,current-sink;
          adi,output-mode = <DRIVER_MODE_SINGLE_DIV>;
          adi,current-source-microamp = <12500>;
        };

        output-clk@9 {
          reg = <9>;
          adi,current-sink;
          adi,output-mode = <DRIVER_MODE_SINGLE_DIV>;
          adi,current-source-microamp = <12500>;
        };
      };
...
```
